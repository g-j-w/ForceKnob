/* ============================================================
 * ssd1306.c —— SSD1306 OLED 驱动（I2C2：PB10=SCL / PB11=SDA）
 *
 * 为什么用独立 I2C2：
 *   编码器 AS5600 独占 I2C1（PB8/PB9）。如果 OLED 也挤在 I2C1，
 *   每 33ms 刷一次全屏会阻塞 ~100ms（100kHz），这期间 1kHz 中断
 *   里的编码器 I2C 读取全部超时失败，角度/速度乱跳、手感发飘。
 *   现在 OLED 走 I2C2，两条总线互不干扰。
 *
 * 显存布局：128×64，横向 8 页、每页 8 行像素。
 *   buffer[x + (y>>3)*128] 的第 (y&7) 位 = (x, y) 点的亮灭。
 * ============================================================ */
#include "ssd1306.h"
#include "i2c.h"          /* 需要 hi2c2 */
#include <string.h>
#include <stdint.h>

#define SSD1306_ADDR    0x3C      /* OLED 7 位地址（SA0=GND 时） */
#define WIDTH           128
#define HEIGHT          64
#define BUFFER_SIZE     (WIDTH * HEIGHT / 8)   /* 128×64/8 = 1024 字节 */

static uint8_t buffer[BUFFER_SIZE];   /* 显存：先画到内存，再一次刷屏 */

/* 6x8 字体（ASCII 32-127），每个字符 6 列 × 8 行 */
static const uint8_t font6x8[96][6] = {
    {0x00,0x00,0x00,0x00,0x00,0x00}, /* ' ' */
    {0x00,0x00,0x5F,0x00,0x00,0x00}, /* '!' */
    {0x00,0x07,0x00,0x07,0x00,0x00}, /* '"' */
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    {0x44,0x64,0x54,0x4C,0x44,0x00}, /* 'z' */
};

/* 发送一条命令：控制字节 0x00 表示后面跟的是命令 */
static void ssd1306_cmd(uint8_t cmd)
{
    uint8_t buf[2] = {0x00, cmd};
    HAL_I2C_Master_Transmit(&hi2c2, SSD1306_ADDR << 1, buf, 2, 10);
}

/* ---------------------------------------------------------------
 * OLED 初始化：SSD1306 上电需要先延时等内部复位，
 * 然后按标准初始化序列设置时钟、显示范围、对比度等，最后开显示。
 * 全是官方推荐值，照抄即可。
 * --------------------------------------------------------------- */
void ssd1306_init(void)
{
    HAL_Delay(100);
    ssd1306_cmd(0xAE);   /* 关显示 */
    ssd1306_cmd(0xD5); ssd1306_cmd(0x80);   /* 显示时钟分频 */
    ssd1306_cmd(0xA8); ssd1306_cmd(0x3F);   /* 复用比 1/64 */
    ssd1306_cmd(0xD3); ssd1306_cmd(0x00);   /* 显示偏移 0 */
    ssd1306_cmd(0x40);                      /* 起始行 0 */
    ssd1306_cmd(0x8D); ssd1306_cmd(0x14);   /* 内部电荷泵开启 */
    ssd1306_cmd(0x20); ssd1306_cmd(0x00);   /* 页寻址模式 */
    ssd1306_cmd(0xA1);                      /* 段重映射（镜像） */
    ssd1306_cmd(0xC8);                      /* COM 扫描方向 */
    ssd1306_cmd(0xDA); ssd1306_cmd(0x12);   /* COM 引脚硬件配置 */
    ssd1306_cmd(0x81); ssd1306_cmd(0xCF);   /* 对比度 0xCF */
    ssd1306_cmd(0xD9); ssd1306_cmd(0xF1);   /* 预充电周期 */
    ssd1306_cmd(0xDB); ssd1306_cmd(0x40);   /* VCOMH 电平 */
    ssd1306_cmd(0xA4);                      /* 全屏点亮关闭 */
    ssd1306_cmd(0xA6);                      /* 正常显示（非反白） */
    ssd1306_cmd(0xAF);                      /* 开显示 */

    ssd1306_clear();
    ssd1306_refresh();
}

/* 清空显存（内存里清，不立刻上屏，等 refresh） */
void ssd1306_clear(void)
{
    memset(buffer, 0, BUFFER_SIZE);
}

/* 画一个像素点：把 (x,y) 落到对应字节的对应位 */
static void draw_pixel(uint8_t x, uint8_t y, uint8_t color)
{
    if (x >= WIDTH || y >= HEIGHT) return;
    if (color)
        buffer[x + (y >> 3) * WIDTH] |= (1 << (y & 7));
    else
        buffer[x + (y >> 3) * WIDTH] &= ~(1 << (y & 7));
}

/* 画一个字符：6×8 点阵，逐列逐位画 */
static void draw_char(uint8_t x, uint8_t y, char c)
{
    if (c < 32 || c > 122) c = '?';    /* 字体表外字符显示成 ? */
    const uint8_t* ch = font6x8[c - 32];
    for (int i = 0; i < 6; i++)
    {
        uint8_t line = ch[i];
        for (int j = 0; j < 8; j++)
            draw_pixel(x + i, y + j, (line >> j) & 1);
    }
}

/* 在 (x,y) 画字符串，超宽自动换行（每字符 6 像素） */
void ssd1306_draw_string(uint8_t x, uint8_t y, const char* str)
{
    while (*str)
    {
        draw_char(x, y, *str++);
        x += 6;
        if (x > WIDTH - 6) { x = 0; y += 8; }
    }
}

/* ---------------------------------------------------------------
 * 刷屏：把显存整块推给 SSD1306
 * 先设列/页地址，再按 32 字节一段发送（I2C 一次传 33 字节 + 控制字节）。
 * 100kHz 下整屏约 100ms（阻塞），400kHz 下约 26ms。
 * --------------------------------------------------------------- */
void ssd1306_refresh(void)
{
    ssd1306_cmd(0x21); ssd1306_cmd(0); ssd1306_cmd(WIDTH - 1);   /* 列地址 0~127 */
    ssd1306_cmd(0x22); ssd1306_cmd(0); ssd1306_cmd(7);           /* 页地址 0~7 */

    for (uint16_t i = 0; i < BUFFER_SIZE; i += 32)
    {
        uint8_t tmp[33];
        tmp[0] = 0x40;                 /* 控制字节 0x40 = 后面是数据 */
        memcpy(&tmp[1], &buffer[i], 32);
        HAL_I2C_Master_Transmit(&hi2c2, SSD1306_ADDR << 1, tmp, 33, 50);
    }
}
